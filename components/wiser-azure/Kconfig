## components/wiser-azure/Kconfig
```kconfig
menu "EB Azure IoT Configuration"

    config EB_AZURE_DPS_ENDPOINT
        string "DPS Global Endpoint"
        default "global.azure-devices-provisioning.net"
        help
            Azure Device Provisioning Service global endpoint.
            This is the same for all Azure accounts.

    config EB_AZURE_DPS_ID_SCOPE
        string "DPS ID Scope"
        default "0ne00XXXXXXX"
        help
            ID Scope from Azure DPS. Format: 0ne00XXXXXX
            Found in Azure Portal > DPS > Overview > ID Scope.
            Use separate scope IDs for your staging and production
            environments, e.g. 0ne00XXXXXXX (staging) / 0ne00YYYYYYY (production).

    config EB_AZURE_DPS_REG_ID_PREFIX
        string "DPS Registration ID Prefix"
        default ""
        help
            Prefix for registration ID. MAC address is appended automatically.
            Leave empty if certificate CN is just the MAC address.
            Example: "" -> 98A316D7FB04, "eb-" -> eb-98A316D7FB04

    config EB_AZURE_IOT_HUB_FQDN
        string "IoT Hub FQDN (optional, cached after DPS)"
        default ""
        help
            Leave empty to use DPS for initial provisioning.
            After first DPS provisioning, hub hostname is cached in NVS
            and this value is ignored on subsequent boots.

    config EB_AZURE_TELEMETRY_INTERVAL_SEC
        int "Telemetry heartbeat interval (seconds)"
        default 60
        range 10 3600
        help
            How often to send status heartbeat telemetry to IoT Hub.

endmenu
```
